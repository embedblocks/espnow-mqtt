## examples/broker/basic_broker/sdkconfig.defaults
```kconfig
# =============================================================================
# basic_broker — sdkconfig.defaults
#
# Applied automatically by "idf.py build". No menuconfig needed for these.
# WiFi SSID and password must still be set via:
#   idf.py menuconfig → Example Configuration → WiFi SSID / WiFi Password
# =============================================================================

# -----------------------------------------------------------------------------
# espnow_mqtt component — broker role
# -----------------------------------------------------------------------------
CONFIG_ESPNOW_MQTT_ROLE_BROKER=y

# Maximum topics a single publisher node can register.
# DEPLOYMENT-WIDE CONTRACT: must match the value on all publisher nodes.
# Broker uses this to cap per-MAC registry entries.
CONFIG_ESPNOW_MQTT_MAX_PUBLISHER_TOPICS=2

# Total (publisher_mac, topic_string) pairs the broker registry can hold.
# Must satisfy: MAX_TOPICS >= expected_publisher_count x MAX_PUBLISHER_TOPICS
# This example: 32 publishers x 2 topics = 64. x2 for OTA headroom = 128.
# A build-time #error fires if MAX_TOPICS < MAX_PUBLISHER_TOPICS.
CONFIG_ESPNOW_MQTT_MAX_TOPICS=64

# Maximum local subscriber callbacks.
CONFIG_ESPNOW_MQTT_MAX_SUBSCRIPTIONS=8

# Dispatch queue depth. Each slot ≈ 284 bytes static RAM.
CONFIG_ESPNOW_MQTT_DISPATCH_QUEUE_SIZE=16

# Drop policy: 0 = drop newest incoming frame when queue full (default).
CONFIG_ESPNOW_MQTT_QUEUE_DROP_POLICY=0

# Per-publisher seq tracking slots.
CONFIG_ESPNOW_MQTT_MAX_TRACKED_PEERS=64

# How often the broker broadcasts BROKER_ANNOUNCE (ms).
# Must be < publisher's NO_REPLY_TIMEOUT_MS (publisher default: 30000).
CONFIG_ESPNOW_MQTT_ANNOUNCE_INTERVAL_MS=10000

# Publisher radio-silence timeout before timeout callback fires (ms).
# Should be >= 2× publisher KEEPALIVE_MS (publisher default: 10000).
CONFIG_ESPNOW_MQTT_PUBLISHER_TIMEOUT_MS=90000

# Broker dispatch task stack and priority.
CONFIG_ESPNOW_MQTT_BROKER_DISPATCH_TASK_STACK=4096
CONFIG_ESPNOW_MQTT_BROKER_DISPATCH_TASK_PRIO=5

# Heap-allocated topic strings: n = inline char[249] per entry (default, simpler).
CONFIG_ESPNOW_MQTT_HEAP_TOPICS=n

# HMAC payload integrity: disabled by default.
CONFIG_ESPNOW_MQTT_PAYLOAD_HMAC=n

# -----------------------------------------------------------------------------
# Logging
# -----------------------------------------------------------------------------
CONFIG_LOG_DEFAULT_LEVEL_INFO=y
CONFIG_LOG_DEFAULT_LEVEL=3
```

## examples/publisher/basic_sensor/sdkconfig.defaults
```kconfig
# =============================================================================
# basic_sensor — sdkconfig.defaults
#
# Applied automatically by "idf.py build". No menuconfig needed for these.
# =============================================================================

# -----------------------------------------------------------------------------
# espnow_mqtt component — publisher role
# -----------------------------------------------------------------------------
CONFIG_ESPNOW_MQTT_ROLE_PUBLISHER=y
CONFIG_ESPNOW_MQTT_PUBLISHER_MODE_CONTINUOUS=y

# Number of topic slots this publisher uses. This example uses 2 (temp + humidity).
# DEPLOYMENT-WIDE CONTRACT: must match MAX_PUBLISHER_TOPICS on the broker.
CONFIG_ESPNOW_MQTT_MAX_PUBLISHER_TOPICS=2


# Publish event queue depth. Each slot ≈ 268 bytes static RAM.
CONFIG_ESPNOW_MQTT_PUBLISHER_EVENT_QUEUE_SIZE=4

# Per-channel probe wait during channel scan (ms).
# 20 ms × 13 channels × 2 topics = 520 ms worst-case scan (well under 3000 ms limit).
CONFIG_ESPNOW_MQTT_CHANNEL_PROBE_MS=20

# Highest WiFi channel number to probe.
CONFIG_ESPNOW_MQTT_MAX_CHANNEL=13

# Random boot delay before first channel probe (ms).
# Spreads simultaneous registrations after a broker reboot.
CONFIG_ESPNOW_MQTT_BOOT_JITTER_MS=500

# Single-slot scan budget for PARTIALLY_REGISTERED recovery (ms).
CONFIG_ESPNOW_MQTT_REGISTER_TIMEOUT_MS=500

# Fast scan cycles before switching to slow fixed-interval retry.
CONFIG_ESPNOW_MQTT_REGISTER_MAX_RETRIES=5

# Slow retry interval after MAX_RETRIES exceeded (ms).
CONFIG_ESPNOW_MQTT_REGISTER_SLOW_INTERVAL_MS=30000

# 0 = retry forever (never enter UNPROVISIONED state).
CONFIG_ESPNOW_MQTT_MAX_REDISCOVER_ATTEMPTS=0

# Consecutive rejections before permanent slot lock.
CONFIG_ESPNOW_MQTT_MAX_CONSECUTIVE_REJECTIONS=10

# Consecutive SEND_FAILs in send_cb before triggering channel rediscover.
CONFIG_ESPNOW_MQTT_INTERNAL_ERR_THRESHOLD=5

# Broker silence timeout before channel rediscover (ms).
# Invariant: must be > KEEPALIVE_MS.
CONFIG_ESPNOW_MQTT_NO_REPLY_TIMEOUT_MS=30000

# Keepalive interval — zero-payload PUBLISH to reset broker timeout timer (ms).
# Must be < NO_REPLY_TIMEOUT_MS.
CONFIG_ESPNOW_MQTT_PUBLISHER_KEEPALIVE_MS=10000

# Publisher task stack and priority.
CONFIG_ESPNOW_MQTT_PUBLISHER_TASK_STACK=4096
CONFIG_ESPNOW_MQTT_PUBLISHER_TASK_PRIO=5

# HMAC payload integrity: disabled by default.
CONFIG_ESPNOW_MQTT_PAYLOAD_HMAC=n

# -----------------------------------------------------------------------------
# Logging
# -----------------------------------------------------------------------------
CONFIG_LOG_DEFAULT_LEVEL_INFO=y
CONFIG_LOG_DEFAULT_LEVEL=3
```

## test_app/sdkconfig.defaults
```kconfig
# sdkconfig.defaults for test_app
# Role: BOTH (publisher + broker) — maximises symbol coverage in tests.
# All publisher and broker code compiled in.

CONFIG_ESPNOW_MQTT_ROLE_BOTH=y

# Publisher: CONTINUOUS mode (SLEEP mode tested via separate sdkconfig)
CONFIG_ESPNOW_MQTT_PUBLISHER_MODE_CONTINUOUS=y

# Conservative sizes for test target (ESP32 or ESP32-C3 dev board)
CONFIG_ESPNOW_MQTT_MAX_PUBLISHER_TOPICS=4
CONFIG_ESPNOW_MQTT_MAX_TOPICS=32
CONFIG_ESPNOW_MQTT_MAX_SUBSCRIPTIONS=8
CONFIG_ESPNOW_MQTT_DISPATCH_QUEUE_SIZE=8
CONFIG_ESPNOW_MQTT_MAX_TRACKED_PEERS=16

# Fast scan for tests
CONFIG_ESPNOW_MQTT_CHANNEL_PROBE_MS=20
CONFIG_ESPNOW_MQTT_BOOT_JITTER_MS=0

# Log level: INFO in test builds (DEBUG would flood the Unity output)
CONFIG_LOG_DEFAULT_LEVEL_INFO=y
CONFIG_LOG_DEFAULT_LEVEL=3
```
